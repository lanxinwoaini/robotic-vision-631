/*******************************************************************/
/*                                                                 */
/* This file is automatically generated by linker script generator.*/
/*                                                                 */
/* Version: Xilinx EDK 8.1.02EDK_I.20.4                                  */
/*                                                                 */
/* Copyright (c) 2004 Xilinx, Inc.  All rights reserved.           */
/*                                                                 */
/* Description : PowerPC405 Linker Script                         */
/*                                                                 */
/*******************************************************************/

_STACK_SIZE = DEFINED(_STACK_SIZE) ? _STACK_SIZE : 0x400;
_HEAP_SIZE = DEFINED(_HEAP_SIZE) ? _HEAP_SIZE : 0x400;

/* Define Memories in the system */

MEMORY
{
   plb_sdram_0 : ORIGIN = 0x00000000, LENGTH = 0x01FFFFFF
   plb_bram_if_cntlr_0 : ORIGIN = 0xFFFF0000, LENGTH = 0x0000FFFF
}

/* Specify the default entry point to the program */

ENTRY(_boot)
STARTUP(boot.o)

/* Define the sections, and where they are mapped in memory */

SECTIONS
{
.vectors : {
   __vectors_start = .;
   *(.vectors)
   __vectors_end = .;
} > plb_bram_if_cntlr_0

.text : {
   *(.text)
   *(.text.*)
   *(.gnu.linkonce.t.*)
} > plb_bram_if_cntlr_0

.init : {
   KEEP (*(.init))
} > plb_bram_if_cntlr_0

.fini : {
   KEEP (*(.fini))
} > plb_bram_if_cntlr_0

.rodata : {
   __rodata_start = .;
   *(.rodata)
   *(.rodata.*)
   *(.gnu.linkonce.r.*)
   __rodata_end = .;
} > plb_bram_if_cntlr_0

.sdata2 : {
   __sdata2_start = .;
   *(.sdata2)
   *(.gnu.linkonce.s2.*)
   __sdata2_end = .;
} > plb_bram_if_cntlr_0

.sbss2 : {
   __sbss2_start = .;
   *(.sbss2)
   *(.gnu.linkonce.sb2.*)
   __sbss2_end = .;
} > plb_bram_if_cntlr_0

.data : {
   __data_start = .;
   *(.data)
   *(.data.*)
   *(.gnu.linkonce.d.*)
   __data_end = .;
} > plb_bram_if_cntlr_0

.got : {
   *(.got)
} > plb_bram_if_cntlr_0

.got1 : {
   *(.got1)
} > plb_bram_if_cntlr_0

.got2 : {
   *(.got2)
} > plb_bram_if_cntlr_0

.ctors : {
   __CTOR_LIST__ = .;
   ___CTORS_LIST___ = .;
   KEEP (*crtbegin.o(.ctors))
   KEEP (*(EXCLUDE_FILE(*crtend.o) .ctors))
   KEEP (*(SORT(.ctors.*)))
   KEEP (*(.ctors))
   __CTOR_END__ = .;
   ___CTORS_END___ = .;
} > plb_bram_if_cntlr_0

.dtors : {
   __DTOR_LIST__ = .;
   ___DTORS_LIST___ = .;
   KEEP (*crtbegin.o(.dtors))
   KEEP (*(EXCLUDE_FILE(*crtend.o) .dtors))
   KEEP (*(SORT(.dtors.*)))
   KEEP (*(.dtors))
   __DTOR_END__ = .;
   ___DTORS_END___ = .;
} > plb_bram_if_cntlr_0

.fixup : {
   __fixup_start = .;
   *(.fixup)
   __fixup_end = .;
} > plb_bram_if_cntlr_0

.eh_frame : {
   *(.eh_frame)
} > plb_bram_if_cntlr_0

.jcr : {
   *(.jcr)
} > plb_bram_if_cntlr_0

.gcc_except_table : {
   *(.gcc_except_table)
} > plb_bram_if_cntlr_0

.sdata : {
   __sdata_start = .;
   *(.sdata)
   *(.gnu.linkonce.s.*)
   __sdata_end = .;
} > plb_bram_if_cntlr_0

.sbss : {
   __sbss_start = .;
   *(.sbss)
   *(.gnu.linkonce.sb.*)
   __sbss_end = .;
} > plb_bram_if_cntlr_0

.tdata : {
   __tdata_start = .;
   *(.tdata)
   *(.gnu.linkonce.td.*)
   __tdata_end = .;
} > plb_bram_if_cntlr_0

.tbss : {
   __tbss_start = .;
   *(.tbss)
   *(.gnu.linkonce.tb.*)
   __tbss_end = .;
} > plb_bram_if_cntlr_0

.bss : {
   __bss_start = .;
   *(.bss)
   *(.gnu.linkonce.b.*)
   *(COMMON)
   . = ALIGN(4);
   __bss_end = .;
} > plb_bram_if_cntlr_0

.boot0 : {
   __boot0_start = .;
   *(.boot0)
   __boot0_end = .;
} > plb_bram_if_cntlr_0

.boot 0xFFFFFFFC : {
   __boot_start = .;
   *(.boot)
   __boot_end = .;
} 

.sdata.framesPerSecond_HW : {
   __sdata.framesPerSecond_HW_start = .;
   *(.sdata.framesPerSecond_HW)
   __sdata.framesPerSecond_HW_end = .;
} > plb_bram_if_cntlr_0

.sdata.framesPerSecond_SW : {
   __sdata.framesPerSecond_SW_start = .;
   *(.sdata.framesPerSecond_SW)
   __sdata.framesPerSecond_SW_end = .;
} > plb_bram_if_cntlr_0

.sbss.courseAngles : {
   __sbss.courseAngles_start = .;
   *(.sbss.courseAngles)
   __sbss.courseAngles_end = .;
} > plb_bram_if_cntlr_0

.sbss.courseAngleTrims : {
   __sbss.courseAngleTrims_start = .;
   *(.sbss.courseAngleTrims)
   __sbss.courseAngleTrims_end = .;
} > plb_bram_if_cntlr_0

.sbss.courseDistances : {
   __sbss.courseDistances_start = .;
   *(.sbss.courseDistances)
   __sbss.courseDistances_end = .;
} > plb_bram_if_cntlr_0

.bss.findPylonWeightsGreen : {
   __bss.findPylonWeightsGreen_start = .;
   *(.bss.findPylonWeightsGreen)
   __bss.findPylonWeightsGreen_end = .;
} > plb_bram_if_cntlr_0

.bss.findPylonWeightsOrange : {
   __bss.findPylonWeightsOrange_start = .;
   *(.bss.findPylonWeightsOrange)
   __bss.findPylonWeightsOrange_end = .;
} > plb_bram_if_cntlr_0

.bss.findPylonWeightsTracking : {
   __bss.findPylonWeightsTracking_start = .;
   *(.bss.findPylonWeightsTracking)
   __bss.findPylonWeightsTracking_end = .;
} > plb_bram_if_cntlr_0

.bss.coursePylons : {
   __bss.coursePylons_start = .;
   *(.bss.coursePylons)
   __bss.coursePylons_end = .;
} > plb_bram_if_cntlr_0

.sdata.unitLength : {
   __sdata.unitLength_start = .;
   *(.sdata.unitLength)
   __sdata.unitLength_end = .;
} > plb_bram_if_cntlr_0

.bss.courseDistances : {
   __bss.courseDistances_start = .;
   *(.bss.courseDistances)
   __bss.courseDistances_end = .;
} > plb_bram_if_cntlr_0

.sdata.errorsSize : {
   __sdata.errorsSize_start = .;
   *(.sdata.errorsSize)
   __sdata.errorsSize_end = .;
} > plb_bram_if_cntlr_0

.sdata.flbuf : {
   __sdata.flbuf_start = .;
   *(.sdata.flbuf)
   __sdata.flbuf_end = .;
} > plb_bram_if_cntlr_0

.sdata.srec_line : {
   __sdata.srec_line_start = .;
   *(.sdata.srec_line)
   __sdata.srec_line_end = .;
} > plb_bram_if_cntlr_0

.sdata.hsvSettingsChange : {
   __sdata.hsvSettingsChange_start = .;
   *(.sdata.hsvSettingsChange)
   __sdata.hsvSettingsChange_end = .;
} > plb_bram_if_cntlr_0

.sdata.sizerequestready : {
   __sdata.sizerequestready_start = .;
   *(.sdata.sizerequestready)
   __sdata.sizerequestready_end = .;
} > plb_bram_if_cntlr_0

.sdata.requestedsize : {
   __sdata.requestedsize_start = .;
   *(.sdata.requestedsize)
   __sdata.requestedsize_end = .;
} > plb_bram_if_cntlr_0

.sdata.requestready : {
   __sdata.requestready_start = .;
   *(.sdata.requestready)
   __sdata.requestready_end = .;
} > plb_bram_if_cntlr_0

.sdata.requestedoptions : {
   __sdata.requestedoptions_start = .;
   *(.sdata.requestedoptions)
   __sdata.requestedoptions_end = .;
} > plb_bram_if_cntlr_0

.sdata.tmpData : {
   __sdata.tmpData_start = .;
   *(.sdata.tmpData)
   __sdata.tmpData_end = .;
} > plb_bram_if_cntlr_0

.sdata.numMetersToRun : {
   __sdata.numMetersToRun_start = .;
   *(.sdata.numMetersToRun)
   __sdata.numMetersToRun_end = .;
} > plb_bram_if_cntlr_0

.sdata.numMillisecondsToRun : {
   __sdata.numMillisecondsToRun_start = .;
   *(.sdata.numMillisecondsToRun)
   __sdata.numMillisecondsToRun_end = .;
} > plb_bram_if_cntlr_0

.sdata.actualPITFreq : {
   __sdata.actualPITFreq_start = .;
   *(.sdata.actualPITFreq)
   __sdata.actualPITFreq_end = .;
} > plb_bram_if_cntlr_0

.sdata.currentTime : {
   __sdata.currentTime_start = .;
   *(.sdata.currentTime)
   __sdata.currentTime_end = .;
} > plb_bram_if_cntlr_0

.sdata.finishedInit : {
   __sdata.finishedInit_start = .;
   *(.sdata.finishedInit)
   __sdata.finishedInit_end = .;
} > plb_bram_if_cntlr_0

.sdata.steeringTrim : {
   __sdata.steeringTrim_start = .;
   *(.sdata.steeringTrim)
   __sdata.steeringTrim_end = .;
} > plb_bram_if_cntlr_0

.sdata.velocityMultiple : {
   __sdata.velocityMultiple_start = .;
   *(.sdata.velocityMultiple)
   __sdata.velocityMultiple_end = .;
} > plb_bram_if_cntlr_0

.sdata.encoderValue : {
   __sdata.encoderValue_start = .;
   *(.sdata.encoderValue)
   __sdata.encoderValue_end = .;
} > plb_bram_if_cntlr_0

.sdata.frames_missed_in_gather : {
   __sdata.frames_missed_in_gather_start = .;
   *(.sdata.frames_missed_in_gather)
   __sdata.frames_missed_in_gather_end = .;
} > plb_bram_if_cntlr_0

.sdata.gathered_frames : {
   __sdata.gathered_frames_start = .;
   *(.sdata.gathered_frames)
   __sdata.gathered_frames_end = .;
} > plb_bram_if_cntlr_0

.sdata.deltaDistance : {
   __sdata.deltaDistance_start = .;
   *(.sdata.deltaDistance)
   __sdata.deltaDistance_end = .;
} > plb_bram_if_cntlr_0

.sdata.framesPerSecond : {
   __sdata.framesPerSecond_start = .;
   *(.sdata.framesPerSecond)
   __sdata.framesPerSecond_end = .;
} > plb_bram_if_cntlr_0

.sdata.framesProcessed : {
   __sdata.framesProcessed_start = .;
   *(.sdata.framesProcessed)
   __sdata.framesProcessed_end = .;
} > plb_bram_if_cntlr_0

.sdata.absoluteAngle : {
   __sdata.absoluteAngle_start = .;
   *(.sdata.absoluteAngle)
   __sdata.absoluteAngle_end = .;
} > plb_bram_if_cntlr_0

.sdata.numAngles : {
   __sdata.numAngles_start = .;
   *(.sdata.numAngles)
   __sdata.numAngles_end = .;
} > plb_bram_if_cntlr_0

.sdata.ADDED_ANGLE : {
   __sdata.ADDED_ANGLE_start = .;
   *(.sdata.ADDED_ANGLE)
   __sdata.ADDED_ANGLE_end = .;
} > plb_bram_if_cntlr_0

.sdata.STRAIGHT_BLIND_DIST : {
   __sdata.STRAIGHT_BLIND_DIST_start = .;
   *(.sdata.STRAIGHT_BLIND_DIST)
   __sdata.STRAIGHT_BLIND_DIST_end = .;
} > plb_bram_if_cntlr_0

.sdata.GUIstate : {
   __sdata.GUIstate_start = .;
   *(.sdata.GUIstate)
   __sdata.GUIstate_end = .;
} > plb_bram_if_cntlr_0

.sdata.TURN_ANGLE : {
   __sdata.TURN_ANGLE_start = .;
   *(.sdata.TURN_ANGLE)
   __sdata.TURN_ANGLE_end = .;
} > plb_bram_if_cntlr_0

.sdata.FIND_RANGE : {
   __sdata.FIND_RANGE_start = .;
   *(.sdata.FIND_RANGE)
   __sdata.FIND_RANGE_end = .;
} > plb_bram_if_cntlr_0

.sdata.TURN_RADIUS : {
   __sdata.TURN_RADIUS_start = .;
   *(.sdata.TURN_RADIUS)
   __sdata.TURN_RADIUS_end = .;
} > plb_bram_if_cntlr_0

.sdata.TURN_SPEED : {
   __sdata.TURN_SPEED_start = .;
   *(.sdata.TURN_SPEED)
   __sdata.TURN_SPEED_end = .;
} > plb_bram_if_cntlr_0

.sdata.BLIND_STRAIGHT_SPEED : {
   __sdata.BLIND_STRAIGHT_SPEED_start = .;
   *(.sdata.BLIND_STRAIGHT_SPEED)
   __sdata.BLIND_STRAIGHT_SPEED_end = .;
} > plb_bram_if_cntlr_0

.sdata.STRAIGHT_SPEED : {
   __sdata.STRAIGHT_SPEED_start = .;
   *(.sdata.STRAIGHT_SPEED)
   __sdata.STRAIGHT_SPEED_end = .;
} > plb_bram_if_cntlr_0

.sdata.lastDeltaDistanceEncoderValue : {
   __sdata.lastDeltaDistanceEncoderValue_start = .;
   *(.sdata.lastDeltaDistanceEncoderValue)
   __sdata.lastDeltaDistanceEncoderValue_end = .;
} > plb_bram_if_cntlr_0

.sdata.desiredAnglePID : {
   __sdata.desiredAnglePID_start = .;
   *(.sdata.desiredAnglePID)
   __sdata.desiredAnglePID_end = .;
} > plb_bram_if_cntlr_0

.sdata.desiredVelocityPID : {
   __sdata.desiredVelocityPID_start = .;
   *(.sdata.desiredVelocityPID)
   __sdata.desiredVelocityPID_end = .;
} > plb_bram_if_cntlr_0

.sdata.encoderPtr_PID : {
   __sdata.encoderPtr_PID_start = .;
   *(.sdata.encoderPtr_PID)
   __sdata.encoderPtr_PID_end = .;
} > plb_bram_if_cntlr_0

.sdata.resendCurrentSectionOnly : {
   __sdata.resendCurrentSectionOnly_start = .;
   *(.sdata.resendCurrentSectionOnly)
   __sdata.resendCurrentSectionOnly_end = .;
} > plb_bram_if_cntlr_0

.sdata.currentlySendingImageAddr : {
   __sdata.currentlySendingImageAddr_start = .;
   *(.sdata.currentlySendingImageAddr)
   __sdata.currentlySendingImageAddr_end = .;
} > plb_bram_if_cntlr_0

.sdata.criticalImageFTE : {
   __sdata.criticalImageFTE_start = .;
   *(.sdata.criticalImageFTE)
   __sdata.criticalImageFTE_end = .;
} > plb_bram_if_cntlr_0

.sdata.currentImageFTE : {
   __sdata.currentImageFTE_start = .;
   *(.sdata.currentImageFTE)
   __sdata.currentImageFTE_end = .;
} > plb_bram_if_cntlr_0

.sdata.currentImageCol : {
   __sdata.currentImageCol_start = .;
   *(.sdata.currentImageCol)
   __sdata.currentImageCol_end = .;
} > plb_bram_if_cntlr_0

.sdata.currentImageRow : {
   __sdata.currentImageRow_start = .;
   *(.sdata.currentImageRow)
   __sdata.currentImageRow_end = .;
} > plb_bram_if_cntlr_0

.sdata.numVisiblePylons : {
   __sdata.numVisiblePylons_start = .;
   *(.sdata.numVisiblePylons)
   __sdata.numVisiblePylons_end = .;
} > plb_bram_if_cntlr_0

.bss.srinfo : {
   __bss.srinfo_start = .;
   *(.bss.srinfo)
   __bss.srinfo_end = .;
} > plb_bram_if_cntlr_0

.bss.sr_buf : {
   __bss.sr_buf_start = .;
   *(.bss.sr_buf)
   __bss.sr_buf_end = .;
} > plb_bram_if_cntlr_0

.bss.sr_data_buf : {
   __bss.sr_data_buf_start = .;
   *(.bss.sr_data_buf)
   __bss.sr_data_buf_end = .;
} > plb_bram_if_cntlr_0

.bss.FrameTable : {
   __bss.FrameTable_start = .;
   *(.bss.FrameTable)
   __bss.FrameTable_end = .;
} > plb_bram_if_cntlr_0

.bss.fte_RecentFromHardware : {
   __bss.fte_RecentFromHardware_start = .;
   *(.bss.fte_RecentFromHardware)
   __bss.fte_RecentFromHardware_end = .;
} > plb_bram_if_cntlr_0

.bss.memTop : {
   __bss.memTop_start = .;
   *(.bss.memTop)
   __bss.memTop_end = .;
} > plb_bram_if_cntlr_0

.bss.courseAngles : {
   __bss.courseAngles_start = .;
   *(.bss.courseAngles)
   __bss.courseAngles_end = .;
} > plb_bram_if_cntlr_0

.sbss.findPylonWeightsGreen : {
   __sbss.findPylonWeightsGreen_start = .;
   *(.sbss.findPylonWeightsGreen)
   __sbss.findPylonWeightsGreen_end = .;
} > plb_bram_if_cntlr_0

.sbss.findPylonWeightsOrange : {
   __sbss.findPylonWeightsOrange_start = .;
   *(.sbss.findPylonWeightsOrange)
   __sbss.findPylonWeightsOrange_end = .;
} > plb_bram_if_cntlr_0

.sbss.findPylonWeightsTracking : {
   __sbss.findPylonWeightsTracking_start = .;
   *(.sbss.findPylonWeightsTracking)
   __sbss.findPylonWeightsTracking_end = .;
} > plb_bram_if_cntlr_0

.bss.truckState : {
   __bss.truckState_start = .;
   *(.bss.truckState)
   __bss.truckState_end = .;
} > plb_bram_if_cntlr_0

.sbss.coursePylons : {
   __sbss.coursePylons_start = .;
   *(.sbss.coursePylons)
   __sbss.coursePylons_end = .;
} > plb_bram_if_cntlr_0

.bss.pid : {
   __bss.pid_start = .;
   *(.bss.pid)
   __bss.pid_end = .;
} > plb_bram_if_cntlr_0

.sbss.outputPID : {
   __sbss.outputPID_start = .;
   *(.sbss.outputPID)
   __sbss.outputPID_end = .;
} > plb_bram_if_cntlr_0

.sbss.regs : {
   __sbss.regs_start = .;
   *(.sbss.regs)
   __sbss.regs_end = .;
} > plb_bram_if_cntlr_0

.bss.hstate : {
   __bss.hstate_start = .;
   *(.bss.hstate)
   __bss.hstate_end = .;
} > plb_bram_if_cntlr_0

.bss.transmitState : {
   __bss.transmitState_start = .;
   *(.bss.transmitState)
   __bss.transmitState_end = .;
} > plb_bram_if_cntlr_0

.sbss.visiblePylons : {
   __sbss.visiblePylons_start = .;
   *(.sbss.visiblePylons)
   __sbss.visiblePylons_end = .;
} > plb_bram_if_cntlr_0

.bss.hsvSettings : {
   __bss.hsvSettings_start = .;
   *(.bss.hsvSettings)
   __bss.hsvSettings_end = .;
} > plb_bram_if_cntlr_0

.sbss.hsvDynamicSettings : {
   __sbss.hsvDynamicSettings_start = .;
   *(.sbss.hsvDynamicSettings)
   __sbss.hsvDynamicSettings_end = .;
} > plb_bram_if_cntlr_0

.sbss.rowCount : {
   __sbss.rowCount_start = .;
   *(.sbss.rowCount)
   __sbss.rowCount_end = .;
} > plb_bram_if_cntlr_0

.sbss.byteArray : {
   __sbss.byteArray_start = .;
   *(.sbss.byteArray)
   __sbss.byteArray_end = .;
} > plb_bram_if_cntlr_0

.bss.hch.1 : {
   __bss.hch.1_start = .;
   *(.bss.hch.1)
   __bss.hch.1_end = .;
} > plb_bram_if_cntlr_0

.bss.recvBufferData : {
   __bss.recvBufferData_start = .;
   *(.bss.recvBufferData)
   __bss.recvBufferData_end = .;
} > plb_bram_if_cntlr_0

.bss.sendBufferData : {
   __bss.sendBufferData_start = .;
   *(.bss.sendBufferData)
   __bss.sendBufferData_end = .;
} > plb_bram_if_cntlr_0

.bss.bpBufferWireless : {
   __bss.bpBufferWireless_start = .;
   *(.bss.bpBufferWireless)
   __bss.bpBufferWireless_end = .;
} > plb_bram_if_cntlr_0

.bss.sendBuffer : {
   __bss.sendBuffer_start = .;
   *(.bss.sendBuffer)
   __bss.sendBuffer_end = .;
} > plb_bram_if_cntlr_0

.bss.recvBuffer : {
   __bss.recvBuffer_start = .;
   *(.bss.recvBuffer)
   __bss.recvBuffer_end = .;
} > plb_bram_if_cntlr_0

/* Generate Stack and Heap Sections */

bss_stack : {
   . += _STACK_SIZE;
   . = ALIGN(16);
   __stack = .;
} > plb_bram_if_cntlr_0

bss_heap : {
   . = ALIGN(16);
   _heap_start = .;
   . += _HEAP_SIZE;
   . = ALIGN(16);
   _heap_end = .;
} > plb_bram_if_cntlr_0

}

